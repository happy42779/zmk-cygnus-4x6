## boards/shields/cygnus/Kconfig.defconfig
```kconfig
#if SHIELD_CYGNUS_LEFT
if SHIELD_CYGNUS_RIGHT

config ZMK_KEYBOARD_NAME
    default "Cygnus"

# for test
config ZMK_SPLIT_ROLE_CENTRAL
    default y

# for test
config ZMK_STUDIO
  default n

endif

if SHIELD_CYGNUS_LEFT || SHIELD_CYGNUS_RIGHT

config ZMK_SPLIT
    default y

endif
```
